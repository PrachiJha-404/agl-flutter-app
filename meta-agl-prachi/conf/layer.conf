## meta-agl-prachi/conf/layer.conf
```bitbake
BBPATH .= ":${LAYERDIR}"
BBFILES += "${LAYERDIR}/recipes-*/*/*.bb"
BBFILE_COLLECTIONS += "agl-prachi"
BBFILE_PATTERN_agl-prachi = "^${LAYERDIR}/"
BBFILE_PRIORITY_agl-prachi = "6"
LAYERDEPENDS_agl-prachi = ""
LAYERSERIES_COMPAT_agl-prachi = "scarthgap"
```
